## components/ringkit/Kconfig
```kconfig
menu "Ringkit"

    config RINGKIT_NET
        bool "Enable ring_net (WebRTC voice)"
        default y
        help
            Compile the ring_net module: Qianwen WebRTC push-to-talk
            (SDP signaling, Opus codec, DataChannel protocol). Disabling
            drops esp_peer and the WebRTC code from the image; applications
            that call ring_net_* will fail to link.

    config RINGKIT_WS
        bool "Enable ring_ws (WebSocket voice)"
        default y
        help
            Compile the ring_ws module: Qianwen WebSocket voice chat
            (session/turn JSON, PCM transport). Disabling drops
            esp_websocket_client from the image; applications that call
            ring_ws_* will fail to link.

    config RINGKIT_CHAT
        bool "Enable ring_chat (STT/LLM/TTS cascade)"
        default y
        help
            Compile the ring_chat module: the STT -> LLM -> TTS cascade
            used by the push-to-talk apps. Disabling drops ring_stt,
            ring_llm and ring_tts; applications that call ring_chat_* will
            fail to link.

    config RINGKIT_GEODIS
        bool "Enable ring_geodis (GEODIS Azure Realtime voice)"
        default y
        help
            Compile the ring_geodis module: GEODIS Voice Agent over WebRTC
            (ephemeral token + Azure Realtime SDP, Opus codec, DataChannel
            protocol, client-executed RAG tool call). Disabling drops the
            GEODIS code from the image; applications that call ring_geodis_*
            will fail to link.

    config RINGKIT_GEODIS_MOCK
        bool "ring_geodis: mock transport (no network, canned replies)"
        depends on RINGKIT_GEODIS
        default n
        help
            Replace the network half of ring_geodis with a local mock: no
            Wi-Fi, no SNTP, no /token, no SDP, no DTLS. The session goes
            CONNECTING -> READY after ~300 ms, commit() triggers a canned
            user transcript, a canned tool call and 1.6 s of canned 48 kHz
            PCM, and barge-in interrupts it like the real thing.

            Everything above the transport is unchanged — same state machine,
            same callbacks, same downlink ring — so an app developed against
            the mock is the app that runs against the gateway. Intended for
            bench work where outbound UDP/DTLS is blocked, and for UI
            development with no gateway budget.

            Adds ~150 KB of flash (the canned clip). Never ship it.

    config RINGKIT_BT
        bool "Enable ring_bt (BLE peripheral)"
        default y
        help
            Compile the ring_bt module: Bluetooth LE peripheral (GAP,
            GATT). Disabling drops bt from the image; applications that
            call ring_bt_* will fail to link.

endmenu
```
